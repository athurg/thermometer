## components/sht3x/Kconfig
```kconfig
menu "SHT3x Configuration"
    config SHT3X_DEVICE_ADDR
        hex "SHT3x device address"
        default 0x44

    config SHT3X_I2C_SDA_PIN_NUM
        int "I2C SDA PIN NUM"
        default 4

    config SHT3X_I2C_SCL_PIN_NUM
        int "I2C SCL PIN NUM"
        default 5
endmenu
```

## main/Kconfig.projbuild
```kconfig
menu "Main APP Configuration"
    config MQTT_URI
        string "MQTT broker URL"
        default "mqtt://mqtt.server.org:1083"

    config WIFI_DEFAULT_SSID
        string "WiFi SSID"
        default "myssid"
        help
            SSID (network name) for the example to connect to.

    config WIFI_DEFAULT_PASSWORD
        string "WiFi Password"
        default "mypassword"
        help
            WiFi password (WPA or WPA2) for the example to use.
            Can be left blank if the network has no security set.
endmenu
```
